#include <Wire.h>
#include <Adafruit_GFX.h>
#include <Adafruit_SSD1306.h>

// OLED display width and height, in pixels
#define SCREEN_WIDTH 128
#define SCREEN_HEIGHT 64
#define SCREEN_I2C_ADDR 0x3C

// SSD1306 display connected to I2C (SDA, SCL pins)
#define OLED_RESET    -1 // Reset pin # (or -1 if sharing Arduino reset pin)
Adafruit_SSD1306 display(SCREEN_WIDTH, SCREEN_HEIGHT, &Wire, OLED_RESET);

// Starting value in integer and fractional parts for the first counter
const unsigned long integerPart = 1;
const unsigned long fractionalPartStart = 301269100; // Latest: https://www.globalwarmingindex.org/
const unsigned long incrementValue = 1;

// Counter for fractional increments for the first counter
unsigned long fractionalPart = fractionalPartStart;
unsigned long integerCounter = integerPart;

// Button pin
const int buttonPin = 2;

// Screen type
enum CounterType { FIRST_COUNTER, ANIMATION };
CounterType currentCounter = FIRST_COUNTER;

// Interval in milliseconds (1 second)
const unsigned long interval = 1000;
unsigned long previousMillis = 0;

// Button debounce variables
unsigned long lastDebounceTime = 0;
const unsigned long debounceDelay = 50; // The debounce time; increase if the output flickers
int buttonState = HIGH;
int lastButtonState = HIGH;

int frame = 0;

// Animation parameters
#define FRAME_DELAY (12)
#define FRAME_WIDTH (64)
#define FRAME_HEIGHT (64)
#define FRAME_COUNT (sizeof(frames) / sizeof(frames[0]))
const byte PROGMEM frames[][512] = {
  {0,0,0,0,0,0,0,0,0,0,0,0,0,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0,0},
  {0,0,0,0,0,0,0,0,0,0,0,0,0,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0,0},
  {0,0,0,0,0,0,0,0,0,0,0,0,0,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0,0},
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  {0,0,0,0,0,0,0,0,0,0,0,0,0,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0,0}
};

// Animation duration
const unsigned long animationDuration = 10000;
unsigned long animationStartTime = 0;

void setup() {
  // Initialize OLED display
  display.begin(SSD1306_SWITCHCAPVCC, SCREEN_I2C_ADDR); 
  
  // Clear the buffer
  display.clearDisplay();
  display.setTextColor(SSD1306_WHITE);

  // Initialize the button pin as input with internal pull-up resistor
  pinMode(buttonPin, INPUT_PULLUP);
}

void loop() {
  // Get the current time in milliseconds
  unsigned long currentMillis = millis();

  // Read the state of the switch into a local variable:
  int reading = digitalRead(buttonPin);

  // Check if the button state has changed
  if (reading != lastButtonState) {
    // Reset the debounce timer
    lastDebounceTime = currentMillis;
  }

  // If the button state has been stable for longer than the debounce delay
  if ((currentMillis - lastDebounceTime) > debounceDelay) {
    // If the button state has changed
    if (reading != buttonState) {
      buttonState = reading;
      // Only toggle the counter display if the new button state is LOW (button pressed)
      if (buttonState == LOW) {
        if (currentCounter == FIRST_COUNTER) {
          currentCounter = ANIMATION;
          animationStartTime = currentMillis;
        } else {
          currentCounter = FIRST_COUNTER;
        }
      }
    }
  }

  // Save the reading. Next time through the loop, it'll be the lastButtonState
  lastButtonState = reading;

  // Check if it's time to increment the counters or update the animation frame
  if (currentMillis - previousMillis >= interval) {
    // Save the last increment time
    previousMillis = currentMillis;

    if (currentCounter == FIRST_COUNTER) {
      // Increment the first counter
      fractionalPart += incrementValue;
      if (fractionalPart >= 1000000000) {
        fractionalPart -= 1000000000;
        integerCounter++;
      }

      // Convert the first counter to a string with leading zeros
      char buffer[11];
      snprintf(buffer, sizeof(buffer), "%09lu", fractionalPart);

      // Combine integer and fractional parts into one string for the first counter
      //char fullNumber[25];
      //snprintf(fullNumber, sizeof(fullNumber), "%lu.%s", integerCounter, buffer);

      // Display GWIndex
      display.clearDisplay();
      display.setCursor(0,0);
      display.setTextSize(1);
      display.print("GLOBAL WARMING INDEX");
      display.fillRect(0, 18, 32, 25, WHITE); // White rectangle
      display.setTextColor(BLACK); // Black text
      display.setTextSize(2);
      display.setCursor(0,20);
      display.print("+");
      display.setTextSize(3);
      display.setCursor(10,20);
      //display.println(fullNumber);
      display.print(integerCounter); // Display the integer part
      display.setTextColor(WHITE); // White text
      display.print(".");
      display.print(buffer); // Display the fractional part
      display.setTextSize(2);
      display.setCursor(95,50);
      display.print((char)247);
      display.print("C");
      // Glitch effect
      for (int i = 0; i < 10; i++) {
        display.startscrollright(0x00, 0x0F);
        delay(5);
        display.stopscroll();
        delay(10);
      }
    } else if (currentCounter == ANIMATION) {
      // Display the animation frame
      display.clearDisplay();
      display.drawBitmap(32, 0, frames[frame], FRAME_WIDTH, FRAME_HEIGHT, 1);
      frame = (frame + 1) % FRAME_COUNT;
      // Check if 10 seconds have passed to switch back to the first counter
      if (currentMillis - animationStartTime >= animationDuration) {
        currentCounter = FIRST_COUNTER;
      }
    }
    // Update the display
    display.display();
  }
}
